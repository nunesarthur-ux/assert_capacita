/******************************************************************************
 * @file Sampler.c
 * @brief Biblioteca responsável pela aquisição e tratamento das amostras do ADC.
 ******************************************************************************/

/*******************************************************************************
 * INCLUDES
 ******************************************************************************/

#include "Sampler.h"
#include "Bsp.h"

/*******************************************************************************
 * DEFINES LOCAIS
 ******************************************************************************/

#define dNUMBER_OF_SAMPLES    100
#define dADC_MAX_VALUE    4095

/*******************************************************************************
 * CONSTANTES
 ******************************************************************************/

/*******************************************************************************
 * ESTRUTURAS DE DADOS LOCAIS
 ******************************************************************************/

static struct
{
    u16 samples[dNUMBER_OF_SAMPLES];

    u16 average;

    u8 percentage;

    int index;

} sampler;

/*******************************************************************************
 * PROTÓTIPOS LOCAIS
 ******************************************************************************/

static void Sampler_CalculateAverage(void);

/*******************************************************************************
 * FUNÇÕES PÚBLICAS
 ******************************************************************************/

/******************************************************************************
 * @brief Inicializa o módulo.
 ******************************************************************************/
void Sampler_Init(void)
{
    int i;

    sampler.average = 0;
    sampler.percentage = 0;
    sampler.index = 0;

    for(i = 0; i < dNUMBER_OF_SAMPLES; i++)
    {
        sampler.samples[i] = 0;
    }
}

/******************************************************************************
 * @brief Atualiza o vetor de amostras.
 ******************************************************************************/
void Sampler_Update(void)
{
    sampler.samples[sampler.index] = Bsp_GetAdc();

    sampler.index++;

    if(sampler.index >= dNUMBER_OF_SAMPLES)
    {
        sampler.index = 0;
    }

    Sampler_CalculateAverage();
}

/******************************************************************************
 * @brief Retorna a média.
 ******************************************************************************/
u16 Sampler_GetAverage(void)
{
    return sampler.average;
}

/******************************************************************************
 * @brief Retorna a porcentagem.
 ******************************************************************************/
u8 Sampler_GetPercentage(void)
{
    return sampler.percentage;
}

/*******************************************************************************
 * FUNÇÕES LOCAIS
 ******************************************************************************/

/******************************************************************************
 * @brief Calcula a média das 100 amostras.
 ******************************************************************************/
static void Sampler_CalculateAverage(void)
{
    int i;

    int sum = 0;

    for(i = 0; i < dNUMBER_OF_SAMPLES; i++)
    {
        sum += sampler.samples[i];
    }

    sampler.average = sum / dNUMBER_OF_SAMPLES;

    sampler.percentage = (sampler.average * 100) / dADC_MAX_VALUE;
}

